## applications/external/wifi_marauder_companion/lib/esp-serial-flasher/zephyr/Kconfig
```kconfig
config ESP_SERIAL_FLASHER
    bool "Enable ESP serial flasher library"
    default y
    select CONSOLE_SUBSYS
    help
      Select this option to enable the ESP serial flasher library.

config ESP_SERIAL_FLASHER_UART_BUFSIZE
    int "ESP Serial Flasher UART buffer size"
    default 512
    help
      Buffer size for UART TX and RX packets

if ESP_SERIAL_FLASHER
    rsource "../Kconfig"
endif
```
